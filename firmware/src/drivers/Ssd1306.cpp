/**
 * @file Ssd1306.cpp
 * @brief SSD1306 初始化、5x7 字体绘制和 I2C 分块刷新实现。
 */
#include "Ssd1306.h"
#include <pgmspace.h>
#include <string.h>

namespace {
struct Glyph { char c; uint8_t col[5]; };

// 精简 5x7 大写字体存放在 Flash，避免引入第三方库并为相机保留 RAM。
const Glyph FONT[] PROGMEM = {
  {' ', {0x00,0x00,0x00,0x00,0x00}}, {'-', {0x08,0x08,0x08,0x08,0x08}},
  {'.', {0x00,0x60,0x60,0x00,0x00}}, {'/', {0x20,0x10,0x08,0x04,0x02}},
  {':', {0x00,0x36,0x36,0x00,0x00}}, {'?', {0x02,0x01,0x51,0x09,0x06}},
  {'0', {0x3E,0x51,0x49,0x45,0x3E}}, {'1', {0x00,0x42,0x7F,0x40,0x00}},
  {'2', {0x42,0x61,0x51,0x49,0x46}}, {'3', {0x21,0x41,0x45,0x4B,0x31}},
  {'4', {0x18,0x14,0x12,0x7F,0x10}}, {'5', {0x27,0x45,0x45,0x45,0x39}},
  {'6', {0x3C,0x4A,0x49,0x49,0x30}}, {'7', {0x01,0x71,0x09,0x05,0x03}},
  {'8', {0x36,0x49,0x49,0x49,0x36}}, {'9', {0x06,0x49,0x49,0x29,0x1E}},
  {'A', {0x7E,0x11,0x11,0x11,0x7E}}, {'B', {0x7F,0x49,0x49,0x49,0x36}},
  {'C', {0x3E,0x41,0x41,0x41,0x22}}, {'D', {0x7F,0x41,0x41,0x22,0x1C}},
  {'E', {0x7F,0x49,0x49,0x49,0x41}}, {'F', {0x7F,0x09,0x09,0x09,0x01}},
  {'G', {0x3E,0x41,0x49,0x49,0x7A}}, {'H', {0x7F,0x08,0x08,0x08,0x7F}},
  {'I', {0x00,0x41,0x7F,0x41,0x00}}, {'J', {0x20,0x40,0x41,0x3F,0x01}},
  {'K', {0x7F,0x08,0x14,0x22,0x41}}, {'L', {0x7F,0x40,0x40,0x40,0x40}},
  {'M', {0x7F,0x02,0x0C,0x02,0x7F}}, {'N', {0x7F,0x04,0x08,0x10,0x7F}},
  {'O', {0x3E,0x41,0x41,0x41,0x3E}}, {'P', {0x7F,0x09,0x09,0x09,0x06}},
  {'Q', {0x3E,0x41,0x51,0x21,0x5E}}, {'R', {0x7F,0x09,0x19,0x29,0x46}},
  {'S', {0x46,0x49,0x49,0x49,0x31}}, {'T', {0x01,0x01,0x7F,0x01,0x01}},
  {'U', {0x3F,0x40,0x40,0x40,0x3F}}, {'V', {0x1F,0x20,0x40,0x20,0x1F}},
  {'W', {0x3F,0x40,0x38,0x40,0x3F}}, {'X', {0x63,0x14,0x08,0x14,0x63}},
  {'Y', {0x07,0x08,0x70,0x08,0x07}}, {'Z', {0x61,0x51,0x49,0x45,0x43}}
};

bool findGlyph(char c, uint8_t out[5]) {
  if (c >= 'a' && c <= 'z') c = static_cast<char>(c - 'a' + 'A');
  for (size_t i = 0; i < sizeof(FONT) / sizeof(FONT[0]); ++i) {
    if (static_cast<char>(pgm_read_byte(&FONT[i].c)) == c) {
      for (uint8_t j = 0; j < 5; ++j) out[j] = pgm_read_byte(&FONT[i].col[j]);
      return true;
    }
  }
  return false;
}
}

bool Ssd1306::command(uint8_t value) {
  wire_.beginTransmission(address_);
  wire_.write(static_cast<uint8_t>(0x00));
  wire_.write(value);
  return wire_.endTransmission() == 0;
}

bool Ssd1306::begin() {
  wire_.beginTransmission(address_);
  if (wire_.endTransmission() != 0) {
    online_ = false;
    return false;
  }

  const uint8_t init[] = {
    0xAE, 0xD5, 0x80, 0xA8, 0x3F, 0xD3, 0x00, 0x40,
    0x8D, 0x14, 0x20, 0x00, 0xA1, 0xC8, 0xDA, 0x12,
    0x81, 0x8F, 0xD9, 0xF1, 0xDB, 0x40, 0xA4, 0xA6,
    0x2E, 0xAF
  };
  online_ = true;
  for (uint8_t value : init) online_ = command(value) && online_;
  clear();
  display();
  return online_;
}

void Ssd1306::clear() { memset(buffer_, 0, sizeof(buffer_)); }

void Ssd1306::pixel(int16_t x, int16_t y, bool on) {
  if (x < 0 || x >= 128 || y < 0 || y >= 64) return;
  uint8_t &cell = buffer_[x + (y / 8) * 128];
  const uint8_t mask = 1U << (y & 7);
  if (on) cell |= mask;
  else cell &= ~mask;
}

void Ssd1306::drawChar(int16_t x, int16_t y, char c, uint8_t scale) {
  uint8_t glyph[5]{};
  if (!findGlyph(c, glyph)) findGlyph('?', glyph);
  for (uint8_t col = 0; col < 6; ++col) {
    const uint8_t bits = col < 5 ? glyph[col] : 0;
    for (uint8_t row = 0; row < 8; ++row) {
      const bool on = bits & (1U << row);
      for (uint8_t dx = 0; dx < scale; ++dx)
        for (uint8_t dy = 0; dy < scale; ++dy)
          pixel(x + col * scale + dx, y + row * scale + dy, on);
    }
  }
}

void Ssd1306::drawText(int16_t x, int16_t y, const char *text, uint8_t scale) {
  if (!text || scale == 0) return;
  while (*text && x < 128) {
    drawChar(x, y, *text++, scale);
    x += 6 * scale;
  }
}

void Ssd1306::display() {
  // 每页分块发送，避免单次写入超过 Wire 缓冲区容量。
  if (!online_) return;
  const uint8_t commands[] = {0x21, 0, 127, 0x22, 0, 7};
  for (uint8_t value : commands) {
    if (!command(value)) { online_ = false; return; }
  }

  for (size_t offset = 0; offset < sizeof(buffer_); offset += 16) {
    wire_.beginTransmission(address_);
    wire_.write(static_cast<uint8_t>(0x40));
    wire_.write(buffer_ + offset, 16);
    if (wire_.endTransmission() != 0) { online_ = false; return; }
  }
}
